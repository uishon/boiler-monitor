## main/Kconfig.projbuild
```kconfig
menu "Communication Configuration"

config WIFI_SSID
    string "WiFi SSID"
    default "my-wifi"
    help
        SSID for the Wi-Fi network to connect to.

config WIFI_PASSWORD
    string "WiFi Password"
    default "my-password"
    help
        Password for the Wi-Fi network.

config MQTT_BROKER_URI
    string "MQTT broker URI"
    default "mqtt://broker.hivemq.com"
    help
        MQTT broker URI used for publishing temperature updates.

config MQTT_TOPIC
    string "MQTT topic"
    default "boiler-monitor/temperature"
    help
        MQTT topic that receives the temperature JSON payload.

config MQTT_CLIENT_ID
    string "MQTT client ID"
    default "boiler-monitor"
    help
        Client identifier used when connecting to the MQTT broker.

config MQTT_USERNAME
    string "MQTT username"
    default ""
    help
        Username used when authenticating with the MQTT broker.

config MQTT_PASSWORD
    string "MQTT password"
    default ""
    help
        Password used when authenticating with the MQTT broker.

endmenu
```
